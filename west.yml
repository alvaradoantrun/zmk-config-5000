## west.yml
```yaml
manifest:
  remotes:
    - name: zmkfirmware
      url-base: https://github.com
  projects:
    - name: zmk
      remote: zmkfirmware
      revision: main
      import:
        path-prefix: app
        file: west.yml
  self:
    path: config
```
